## Kconfig
```kconfig
menu "Bihar Wifi module"
            
    menu "BI_WIFI"
        config FIREBASE_TOKEN_REFRESH_TIME_MS
            int "Firebase token refresh time"
            default 3000000
            range 1 3000000
            help
                Firebase token refresh time in ms

    endmenu
  
endmenu
```
